## IDE/Espressif/ESP-IDF/examples/AWS_IoT_MQTT/components/wolfmqtt/Kconfig
```kconfig
#
# Copyright (C) 2006-2022 wolfSSL Inc.  All rights reserved.
#
# This file is part of wolfSSL.
#
# Contact licensing@wolfssl.com with any questions or comments.
#
# https://www.wolfssl.com
#/
#
# Kconfig for wolfssl
#
#
# see project CMakeLists.txt file to enable wolfMQTT with USE_MQTT_LIBRARY

menu "wolfMQTT"

    config USE_WOLFMQTT
        bool "Use wolfMQTT (requires wolfSSL)"
        default y

    config USE_WOLFMQTT_TLS
        bool "Use TLS for wolfMQTT (requires wolfSSL)"
        default y

    config DEBUG_WOLFMQTT
        bool "Enable debug messages for wolfMQTT"
        default y

    config VERBOSE_WOLFMQTT_CMAKE
        bool "Enable verbose messages for wolfMQTT in CMake"
        default y

endmenu # wolfMQTT
```

## zephyr/Kconfig
```kconfig
menuconfig WOLFMQTT
	bool "wolfMQTT module support"

if WOLFMQTT
config WOLFMQTT_SETTINGS_FILE
	string "wolfMQTT settings file"
	help
	  Use a specific wolfMQTT settings file.

config WOLFMQTT_TLS
	bool "wolfMQTT TLS support"
	default n
	select WOLFSSL

config ZEPHYR_WOLFMQTT_MODULE
	bool
	depends on WOLFMQTT
endif
```

## zephyr/samples/client/sample.yaml
```yaml
sample:
  description: MQTT client sample application
  name: MQTT client
common:
  harness: console
  harness_config:
    type: one_line
    regex:
      - "Zephyr MQTT test passed"
tests:
  sample.lib.wolfmqtt_client:
    timeout: 10
    platform_allow: qemu_x86
    integration_platforms:
      - qemu_x86
```

## zephyr/samples/client_tls/sample.yaml
```yaml
sample:
  description: MQTT client sample application with TLS
  name: MQTT TLS client
common:
  harness: console
  harness_config:
    type: one_line
    regex:
      - "Zephyr MQTT test passed"
tests:
  sample.lib.wolfmqtt_client_tls:
    timeout: 10
    platform_allow: qemu_x86
    integration_platforms:
      - qemu_x86
```
